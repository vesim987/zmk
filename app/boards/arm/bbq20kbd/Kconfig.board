## app/boards/arm/bbq20kbd/Kconfig.board
```kconfig
# Copyright (c) 2023 ZMK contributors
# SPDX-License-Identifier: Apache-2.0

config BOARD_SOLDER_PARTY_BBQ20KBD
	bool "Solder Party BBQ20KBD"
	depends on SOC_RP2040
```

## app/boards/arm/bbq20kbd/Kconfig.defconfig
```kconfig
if BOARD_SOLDER_PARTY_BBQ20KBD

config BOARD
	default "bbq20kbd"

config RP2_FLASH_W25Q080
	default y

endif # BOARD_SOLDER_PARTY_BBQ20KBD
```
